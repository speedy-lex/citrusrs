/dts-v1/;
/ {
    compatible = "riscv-virtio";
    #address-cells = <2>;
    #size-cells = <2>;

    memory@80000000 {
        device_type = "memory";
        reg = <0x0 0x80000000 0x0 0x02000000>; // 32 MB
    };

    chosen {
        stdout-path = "/serial0";
    };

    serial0: serial@10000000 {
        compatible = "ns16550a";
        reg = <0x0 0x10000000 0x0 0x100>;
        clock-frequency = <50000000>;
    };
};

